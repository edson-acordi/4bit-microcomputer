// =================================================================================
// This program is used to transfer a compiled program (hex codes)to MikroLeo
// using Arduino Mega 2560
//
// Visit the project's repository and support it!
// https://github.com/edson-acordi/4bit-microcomputer
//
// By Edson Junior Acordi
// Last revision: Version v1.0 - December 04, 2021
//
// License: GNU GPL v3
//
// Usage:
// Copy the code generated by MikroLeoAsm.py identified in the section
// "Code to be transferred to the MikroLeo (using Arduino):" to the following array,
//
// word program_dat[] = {
// };
//
// For more details, see the MikroLeo documentation.

// The code was adapted from:
// https://github.com/mbocaneg/arduino_eeprom_programmer
// Thanks mbocaneg

// Note:
// The "dataWrite(program_dat[i])" function is used to put data from the current
// position of the program_dat[] array to the Arduino Data pins.
// ================================================================================= 

// **********************************************************************************
// ******************* CHANGE THESE VALUES WITH YOUR PROGRAM CODE *******************
// **********************************************************************************

// HARD CODED hex values to be written to MikroLeo Program Memory
word program_dat[] = {
// Paste the compiled code here

// ---- Program Examples ----
// Square Waveform on OUTA
// 0x0401, 0x0F00, 0x0400, 0x0C00 // CLK is divided by 4 - Duty cycle of 50%
// Square Waveform on OUTA
// 0x0401, 0x0400, 0x0C00 // CLK is divided by 3 - Duty cycle of 33.33%

// Square Wavefrom on OUTA - 5 cycles of period Ton = 2 period, Toff = 3 period
//0x0001, 0x1400, 0x0000, 0x1400, 0x0c00

// Blink LED2 (use it clocked at 555)
0x0001, 0x1400, 0x1400, 0x1400, 0x1400, 0x1400, 0x1400, 0x1400, 0x1400, 0x1400, 0x1400, 0x1400, 0x1400, 0x1400, 0x1400, 0x1400,
0x1400, 0x1400, 0x1400, 0x1400, 0x1400, 0x0000, 0x1400, 0x1400, 0x1400, 0x1400, 0x1400, 0x1400, 0x1400, 0x1400, 0x1400, 0x1400,
0x1400, 0x1400, 0x1400, 0x1400, 0x1400, 0x1400, 0x1400, 0x1400, 0x1400, 0x0c00
// ---- End of Program Examples ----

};

// **********************************************************************************
// **********************************************************************************
// **********************************************************************************

// ==== I/O Definitions for Write to MikroLeo Program Memory ====
// Program Memory Control Signals (tied to VDD with pull-up resistor)
int WE = 11; // Digital Pin used as /WE

// Control Signals for MikroLeo
int RSTPC = 10; // Digital Pin used as /RSTPC
int STEP = 9; // Digital Pin used as STEP

// Definition of pins used for write Data to Program Memory
int dbit0 = A0; // Digital Pin used as Data0 - MikroLeo, Programmer (ROML) J17 => D0
int dbit1 = A1; // Digital Pin used as Data1 - MikroLeo, Programmer (ROML) J17 => D1
int dbit2 = A2; // Digital Pin used as Data1 - MikroLeo, Programmer (ROML) J17 => D2
int dbit3 = A3; // ...
int dbit4 = A4;
int dbit5 = A5;
int dbit6 = A6;
int dbit7 = A7; // Digital Pin used as Data7 - MikroLeo, Programmer (ROML) J17 => D7

int dbit8 = A8; // Digital Pin used as Data8 - MikroLeo, Programmer (ROMH) J18 => D8
int dbit9 = A9; // Digital Pin used as Data9 - MikroLeo, Programmer (ROMH) J18 => D9
int dbit10 = A10; // Digital Pin used as Data9 - MikroLeo, Programmer (ROMH) J18 => D10
int dbit11 = A11; // ...
int dbit12 = A12;
int dbit13 = A13;
int dbit14 = A14;
int dbit15 = A15; // Digital Pin used as Data15 - MikroLeo, Programmer (ROMH) J18 => D15

int dbArray [] = {
    dbit0, dbit1, dbit2, dbit3, dbit4, dbit5, dbit6, dbit7, dbit8, dbit9, dbit10, dbit11, dbit12, dbit13, dbit14, dbit15}; 

void setup() {               
  // ---- Configuration ----
  // Set pins connected to Program Memory and control signals as outputs, set them HIGH
  pinMode(WE, OUTPUT); // Write Enable is an output pin
  pinMode(RSTPC, OUTPUT); // Reset PC is an output pin
  pinMode(STEP, OUTPUT); // STEP is an output pin

  digitalWrite(WE, HIGH); // Disable "Write Enable"
  digitalWrite(STEP, LOW); // Set STEP to Low (prepare PC increment)
  digitalWrite(RSTPC, HIGH); // Set RSTPC to High (disable "Reset PC")

  delay(100);

  ResetPC(); // Reset MikroLeo Program Counter (PC)
  
  // Set Data pins to OUTPUT (Write Operation)
  for (int i = 0; i < sizeof(dbArray)/sizeof(int); i++){
    pinMode(dbArray[i], OUTPUT);
  }
} // ---- End of Configuration ----

void loop() {
  // ---- Main program ----
  // Iterate through word array holding data to be written
  for (int i = 0; i < sizeof(program_dat)/sizeof(word); i++){

    dataWrite(program_dat[i]); // Write data at current position of array program_dat[] to data lines

    IncPC(); // Finish Write at the current address and Increment PC

  }

  // Disable WE chip - Finish the data Write
  digitalWrite(WE, HIGH);
  
  // Set Data pins to INPUT (to not interfere when MikroLeo is running a program)
  Data_Pins_to_Input();

  // Infinite loop to avoid going back to beginning
  while(1){}
} // ---- End of Main program ----

// ---- Fuctions ----
void dataWrite(int data){
  // Make sure WE is disabled
  digitalWrite(WE, HIGH);
  
  int dat = data;

  // Convert data into binary value, write value to data lines
  for(int i = 0; i<=15; i++){
   
    if((dat & 1) == 1){
      digitalWrite(dbArray[i], HIGH);
    }
    else{
      digitalWrite(dbArray[i], LOW);
    }
    dat = dat >> 1;
 
  }

  // Enable WE chip - Write the current Data
  digitalWrite(WE, LOW);
  
  delay(5); // Delay so things settle

}

// After all data is written to MikroLeo, Set Data pins to Input
void Data_Pins_to_Input(){

  digitalWrite(WE, HIGH);

  // Data pins are now inputs
  for (int i = 0; i < sizeof(dbArray)/sizeof(int); i++){
    pinMode(dbArray[i], INPUT);
  }

  digitalWrite(WE, HIGH); 
}

void ResetPC(){
  digitalWrite(RSTPC, LOW); // Reset the MikroLeo Program Couter (PC)
  delay(100);
  digitalWrite(RSTPC, HIGH); // Disable signal "Reset PC"
}

void IncPC(){
  digitalWrite(STEP, HIGH); // Step Pulse to HIGH, prepare to increment the PC
  delay(10);
  digitalWrite(STEP, LOW); // Step Pulse to LOW, increment PC
  delay(10);
}
// ---- End of Fuctions ----
